## west.yml
```yaml
manifest:

  remotes:
    - name: sdk
      url-base: https://github.com/nrfconnect

  projects:
    - name: sdk-nrf
      remote: sdk
      revision: v2.6.1
      path: nrf
      import:
        name-blocklist:
          - ci-tools
          - hal_altera
          - hal_cypress
          - hal_infineon
          - hal_microchip
          - hal_nxp
          - hal_openisa
          - hal_silabs
          - hal_xtensa
          - hal_ti
          - loramac-node
          - net-tools
          - edtt
          - trusted-firmware-m
          - sof
      clone-depth: 1
      board: nrf52dk_nrf52832 # Specify your custom board
      build-dir: build # Customize the build directory


    
```
